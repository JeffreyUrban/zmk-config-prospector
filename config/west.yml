## config/west.yml
```yaml
manifest:
  remotes:
    - name: zmkfirmware
      url-base: https://github.com/zmkfirmware
    - name: prospector
      url-base: https://github.com/t-ogura
    - name: jeffreyurban
      url-base: https://github.com/JeffreyUrban
  projects:
    - name: zmk
      remote: zmkfirmware
      revision: main
      import: app/west.yml
    - name: prospector-zmk-module
      remote: jeffreyurban
      revision: main
      path: modules/prospector-zmk-module
  self:
    path: config
```
